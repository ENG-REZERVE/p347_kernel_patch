## media/i2c/Kconfig.i2c
```kconfig
config VIDEO_AD9389B
	tristate "Analog Devices AD9389B encoder"
	default n
	depends on VIDEO_V4L2 && I2C && VIDEO_V4L2_SUBDEV_API
	---help---
	  Support for the Analog Devices AD9389B video encoder.

	  This is a Analog Devices HDMI transmitter.

	  To compile this driver as a module, choose M here: the
	  module will be called ad9389b.
```
